## app/boards/arm/wirelice/Kconfig.board
```kconfig
# wirelice rev2 board configuration

# Copyright (c) 2020 The ZMK Contributors
# SPDX-License-Identifier: MIT

config BOARD_WIRELICE
	bool "wirelice Keyboard"
	depends on SOC_NRF52840_QIAA
```
